
// Libraries
#include <SPI.h>
#include <Wire.h>
#include <Adafruit_GFX.h>
#include <Adafruit_SSD1306.h>
#include <ESP8266WiFi.h>
#include <Fonts/FreeMono9pt7b.h>


bool const debug = false;
const long interval = 3000;


// Variables for the blinking microscope 
bool const microscope = true;
const byte green_LED = D5;
const byte red_LED = D6;


// Variables for the WB chamber
bool const chamber = true;
#define SCREEN_WIDTH 128 // OLED display width, in pixels
#define SCREEN_HEIGHT 64 // OLED display height, in pixels
#define OLED_RESET     -1 // Reset pin # (or -1 if sharing Arduino reset pin)
Adafruit_SSD1306 display(SCREEN_WIDTH, SCREEN_HEIGHT, &Wire, OLED_RESET);

// Images
const unsigned char bitmap_hand [] PROGMEM = {
  0x00, 0x00, 0x00, 0x00, 0x00, 0x00, 0x00, 0x00, 0x00, 0x00, 0x00, 0x00, 0x00, 0x00, 0x00, 0x00, 
  0x00, 0x00, 0x00, 0x00, 0x00, 0x00, 0x00, 0x00, 0x00, 0x00, 0x00, 0x00, 0x00, 0x00, 0x00, 0x00, 
  0x00, 0x00, 0x00, 0x00, 0x00, 0x00, 0x00, 0x00, 0x00, 0x00, 0x00, 0x00, 0x00, 0x00, 0x00, 0x00, 
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  0x00, 0x00, 0x00, 0x00, 0x00, 0x00, 0x00, 0x00, 0x00, 0x00, 0x00, 0x00, 0x00, 0x00, 0x00, 0x00
};

const unsigned char bitmap_giuacchi [] PROGMEM = {
  0x00, 0x00, 0x00, 0x00, 0x00, 0x00, 0x00, 0x00, 0x00, 0x00, 0x00, 0x00, 0x00, 0x00, 0x00, 0x00, 
  0x00, 0x00, 0x00, 0x00, 0x00, 0x00, 0x00, 0x00, 0x00, 0x00, 0x00, 0x00, 0x00, 0x00, 0x00, 0x00, 
  0x00, 0x00, 0x00, 0x00, 0x00, 0x00, 0x00, 0x00, 0x00, 0x00, 0x00, 0x00, 0x00, 0x00, 0x00, 0x00, 
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  0x00, 0x00, 0x00, 0x00, 0x00, 0x00, 0x00, 0x00, 0x00, 0x00, 0x00, 0x00, 0x00, 0x00, 0x00, 0x00
};
const unsigned char bitmap_vaffanculo [] PROGMEM = {
  0x00, 0x00, 0x00, 0x00, 0x00, 0x00, 0x00, 0x00, 0x00, 0x00, 0x00, 0x00, 0x00, 0x00, 0x00, 0x00, 
  0x00, 0x00, 0x00, 0x00, 0x00, 0x00, 0x00, 0x00, 0x00, 0x00, 0x00, 0x00, 0x00, 0x00, 0x00, 0x00, 
  0x00, 0x00, 0x00, 0x00, 0x00, 0x00, 0x00, 0x00, 0x00, 0x00, 0x00, 0x00, 0x00, 0x00, 0x00, 0x00, 
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  0x00, 0x00, 0x00, 0x00, 0x00, 0x00, 0x00, 0x00, 0x00, 0x00, 0x00, 0x00, 0x00, 0x00, 0x00, 0x00
};

void setup() {

  if (debug) {
    Serial.begin(115200);
  }

  // New random seed each iteration of the sketch
  randomSeed(analogRead(0));


  // Turn off Wifi to save battery
  WiFi.mode(WIFI_OFF);

  if (microscope) {
    pinMode(green_LED, OUTPUT);
    pinMode(red_LED, OUTPUT);
  }
  
  display.begin(SSD1306_SWITCHCAPVCC, 0x3C);
  display.setRotation(2);
  display.setFont(&FreeMono9pt7b);
  display.display();
  delay(1000);

}

// the loop function runs over and over again forever
void loop() {

  if (chamber) {
    display.clearDisplay();
    display.display();    
  }

  if (microscope) {

    delay(500);
    digitalWrite(green_LED, HIGH);
    delay(interval);
    digitalWrite(green_LED, LOW);
    digitalWrite(red_LED, HIGH);
    delay(interval-200);
    digitalWrite(red_LED, LOW);
    delay(500);
    
  }

  if (chamber) {

    int chamber_choice = random(12);

    if (chamber_choice == 1) {

      draw_text_static("Cazzo!");
      
    } else if (chamber_choice == 2) {

      draw_text_static("Coffice!?");
      
    } else if (chamber_choice == 3) {

      draw_bitmap(bitmap_hand);
      
    } else if (chamber_choice == 4) {

      draw_text_static("WALLERA");
      
    } else if (chamber_choice == 5) {

      draw_bitmap(bitmap_vaffanculo);
      
    } else if (chamber_choice == 6) {

      draw_bitmap(bitmap_giuacchi);
      
    } else {
      
      draw_gel();
      
    }
  }
}

void draw_rectangle(int i) {
  
  display.clearDisplay();
  display.drawRect(i, i, display.width()-2*i, display.height()-2*i, WHITE);
  display.display();      // Show initial text
  delay(100);

}

void draw_text_static(const char *text) {

  int16_t x1, y1;
  uint16_t w, h;
  int scale_factor = 1;
  int x_offcenter_compensation = 3;
  int y_offcenter_compensation = 3;
  int i = 20;
  
  display.clearDisplay();
  display.setTextColor(WHITE);
  display.getTextBounds(text, 0, 0, &x1, &y1, &w, &h); // calc width of new string
  display.setCursor((display.width()/2) - (w/2) - x_offcenter_compensation, (SCREEN_HEIGHT / 2) + (h/2) - y_offcenter_compensation);
  display.print(text);
  display.display();
  delay(5000);
  
}

void draw_bitmap(const uint8_t *bitmap) {
  
  display.clearDisplay();
  display.drawBitmap(0, 0, bitmap, 128, 64, WHITE);
  display.display();
  delay(5000);
  
}

void draw_gel(void) {

  int x_min = 8;
  int w_max = 110;
  int y_min = 3;
  int h_max = 59;

  int n_lanes = 4;
  int lane_thickness = 5;
  int lane_padding = 5;
  float lane_width = (float) (((w_max - x_min) - (n_lanes-1) * lane_padding) / n_lanes);

  // Generate random bands for each lane, but make it sparse
  int bands[n_lanes+1][h_max+51];
  for (int i = 0; i <= n_lanes; i++) {
    for (int j = 1; j <= (h_max+50); j++) {
      if (((j / 3) & 1) == 0) {
        int tmp = random(20);
        if (tmp == 0) {
          bands[i][j] = 0;
        } else {
          bands[i][j] = 1;
        }
      }
    }
  }
  
    
  // Draw front
  for (int j = 1; j <= h_max; j++) {
    display.clearDisplay();
    for (int i = 1; i <= n_lanes; i++) {
      
      display.drawRect(round(x_min + lane_padding + (lane_width + lane_padding) * (i-1)), 
                       y_min + lane_padding, 
                       round(lane_width), 
                       lane_thickness, WHITE);
      
    }
    for (int i = 1; i <= n_lanes; i++) {
      
      display.fillRect(round(x_min + lane_padding + (lane_width + lane_padding) * (i-1)), 
                       y_min + lane_padding + j, 
                       round(lane_width), 
                       lane_thickness, WHITE);
      
    }
    for (int i = 1; i <= n_lanes; i++) {
      for (int k = 1; k <= j; k++) {
        if (bands[i][k] == 0) {
          display.fillRect(round(x_min + lane_padding + (lane_width + lane_padding) * (i-1)), 
                 y_min + lane_padding + k, 
                 round(lane_width), 
                 lane_thickness-2, WHITE);
        }
      }
    }
    
    display.display();
    delay(200);
  }

  // Clean array
  memset(bands, 1, sizeof(bands));

}
